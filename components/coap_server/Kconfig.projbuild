## components/coap_server/Kconfig.projbuild
```kconfig
menu "COAP configuration"

    config COAP_SERVER_URL
        string "COAP server uri"
        help
            URL of the COAP server.
endmenu
```

## components/mqtt_api/Kconfig.projbuild
```kconfig
menu "MQTT configuration"

    config MQTT_BROKER_URL
        string "MQTT broker url"
        help
            URL of the MQTT broker.

    config MQTT_USERNAME
        string "MQTT broker username"
        help
            Username to access the MQTT broker.

    config MQTT_PASSWORD
        string "MQTT broker password"
        help
            Password to access the MQTT broker.
endmenu
```

## components/power_mngr/Kconfig.projbuild
```kconfig
menu "POWER Manager"

    config HORA_INICIO
        int "hora inicio"
        default 8
        help 
            Ingrese hora en la que comenzara el dispositivo a funcionar
    
    config MINUTO_INICIO
        int "minuto inicio"
        default 0
        help
            Ingrese minuto en la que comenzara el dispositivo a funcionar


    config HORA_FINAL
        int "hora final"
        default 22
        help 
            Ingrese hora en la que terminara el dispositivo de funcionar
    
    config MINUTO_FINAL
        int "minuto final"
        default 0
        help
            Ingrese minuto en la que terminara el dispositivo de funcionar

endmenu
```

## components/si7021-sgp30/Kconfig.projbuild
```kconfig
menu "Sensores configuration."
    ###menu lector de temperatura
    config PERIODO_TEMP
        int "Periodo en segundos de muestreo de la temperatura."
        default 5
        help
            "Intervalo muestreo temperatura"
endmenu
```

## components/sueno-profundo/Kconfig.projbuild
```kconfig
menu "Sueño profundo"

    config HORA_INICIO
        int "hora inicio"
        default 8
        help 
            Ingrese hora en la que comenzara el dispositivo a funcionar
    
    config MINUTO_INICIO
        int "minuto inicio"
        default 0
        help
            Ingrese minuto en la que comenzara el dispositivo a funcionar

    config SEGUNDO_INICIO
        int "segundo inicio"
        default 0
        help
            Ingrese SEGUNDO en la que comenzara el dispositivo a funcionar



    config HORA_FINAL
        int "hora final"
        default 22
        help 
            Ingrese hora en la que terminara el dispositivo de funcionar
    
    config MINUTO_FINAL
        int "minuto final"
        default 0
        help
            Ingrese minuto en la que terminara el dispositivo de funcionar

    config SEGUNDO_FINAL
        int "segundo final"
        default 0
        help
            Ingrese SEGUNDO en la que terminara el dispositivo de funcionar
endmenu
```

## components/thingsboard/Kconfig.projbuild
```kconfig
menu "Thingsboard configuration"

    config THINGSBOARD_URL
        string "Thingsboard url"
    
    config THINGSBOARD_PROVISION_DEVICE_KEY
        string "Device key para el provisionamiento via Thingsboard."

    config THINGSBOARD_PROVISION_DEVICE_SECRET
        string "Device secret para el provisionamiento via Thingsboard."

    # config THINGSBOARD_DEVICE_TOKEN
    #     string "Thingsboard device token"
    #     help
    #         Temporal, hasta que tengamos el provisionamiento.

    choice Protocolo
        bool "Protocolo de comunicación"
        default USE_COAP

    config USE_MQTT
        bool "mqtt"

    config USE_COAP
        bool "coap"

    endchoice

    config COAP_WAIT_MS
        int "Tiempo de espera para coap_io_process"
        default 20000
        depends on USE_COAP

endmenu
```

## sdkconfig.defaults
```kconfig
CONFIG_MBEDTLS_SSL_PROTO_DTLS=y
CONFIG_COAP_CLIENT_SUPPORT=y
CONFIG_COMPILER_OPTIMIZATION_SIZE=y
```
